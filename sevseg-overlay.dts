// Definitions for sevseg module
/dts-v1/;
/plugin/;

/ {
	compatible = "brcm,bcm2835";
	fragment@0 {
		target-path = "/";
		__overlay__ {
			sevseg_device {
				compatible = "sevseg";
				status = "okay";
				select-gpios =	<&gpio 21 0>,
								<&gpio 20 0>,
								<&gpio 16 0>;

				buffer-clk-gpios =	<&gpio 6 0>;
				buffer-mosi-gpios =	<&gpio 13 0>;
			};
		};
	};
};
